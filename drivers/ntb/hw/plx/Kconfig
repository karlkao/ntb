## drivers/ntb/hw/plx/Kconfig
```kconfig
config NTB_PLX
	tristate "PLX Non-Transparent Bridge support"
	depends on X86_64
	help
	 This driver supports PLX NTB on capable PCIe switch. The switch must be
	 configured to feature one back-to-back NTB port. Two memory windows are
	 supported (64-bit and 32-bit addressing).

	 If unsure, say N.
```
